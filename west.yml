## west.yml
```yaml
# The west manifest for Testing west to build sphinx multi projects
# Says workspace is docs_all/{build,source}
# Under docs_all/ you can many topics, many sphinx project docs.
# this

manifest:
  # west schema version
  version: "1.2"
  remotes:
    # short name for remote base path, RichGH
    - name: RichGH
      url-base: https://github.com/richMetellus
  projects:
    # list of projects managed by west
    # download to <workspace-name>/...
    - name: Wiki_Embedded_System
      remote: RichGH
      revision: main
      path: topics/Wiki_EmbedSysGen
      # set to import all for now, but will trim down using the
      # name-allowlist
      # import: true
      submodules: true
    - name: Wiki_ElectricalElectronics
      remote: RichGH
      revision: main
      path: topics/Wiki_EE
      submodules: true
    - name: Wiki_NetworkEngineering
      remote: RichGH
      revision: main
      path: topics/Wiki_NetworkEngineering
      submodules: true
    - name: Wiki_CommunicationProtocols
      remote: RichGH
      revision: main
      path: topics/Wiki_CommunicationProtocols
    - name: Wiki_Programming
      remote: RichGH
      path: topics/Prog/Wiki_ProgrammingGen
      revision: main
      import: true
  defaults:
    remote: RichGH
    revision: main
  self:
    # this repository will be cloned to manifest_repo
    # west to download this to <workspace-name>/manifest_repo
    # or leave default path to the name of the repository
    path: 000-manifest_repo
```
